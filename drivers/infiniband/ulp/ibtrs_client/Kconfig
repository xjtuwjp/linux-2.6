## drivers/infiniband/ulp/ibtrs_client/Kconfig
```kconfig
config INFINIBAND_IBTRS_CLT
	tristate "InfiniBand IBTRS CLIENT"
	depends on INFINIBAND_ADDR_TRANS
	---help---
	  Support for the simplified data transfer over InfiniBand.
	  This offer API to user module IBNBD_CLIENT

	  The IBTRS protocol is defined by the ProfitBricks GmbH.
```

## drivers/infiniband/ulp/ibtrs_server/Kconfig
```kconfig
config INFINIBAND_IBTRS_SRV
	tristate "InfiniBand IBTRS SERVER"
	depends on INFINIBAND_ADDR_TRANS
	---help---
	  Support for the simplified data transfer over InfiniBand.
	  This offer API to user module IBNBD_SERVER

	  The IBTRS protocol is defined by the ProfitBricks GmbH.
```
